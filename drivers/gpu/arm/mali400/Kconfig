## drivers/gpu/arm/mali400/Kconfig
```kconfig
config MALI400
	tristate "Mali-300/400/450 support"
	depends on ARM || ARM64
	select DMA_SHARED_BUFFER
	---help---
	  This enables support for the ARM Mali-300, Mali-400, and Mali-450
	  GPUs.

	  To compile this driver as a module, choose M here: the module will be
	  called mali.

config MALI450
	bool "Enable Mali-450 support"
	depends on MALI400
	---help---
	  This enables support for Mali-450 specific features.

config MALI470
	bool "Enable Mali-470 support"
	depends on MALI400
	---help---
	  This enables support for Mali-470 specific features.

choice
	prompt "Platform configuration"
	depends on (MALI400 || MALI450 || MALI470)
	default MALI_PLATFORM_S5P6818 if ARM64
	default MALI_PLATFORM_S5P4418 if ARM
	help
	  Select the SOC platform that contains a Mali utgard GPU

config MALI_PLATFORM_S5P4418
	depends on ARCH_S5P4418
	bool "Nexell S5P4418"
	select MALI_SHARED_INTERRUPTS
	select MALI_DT
	help
	  Select S5P4418 SoC configuration

config MALI_PLATFORM_S5P6818
	depends on ARCH_S5P6818
	bool "Nexell S5P6818"
	select MALI_SHARED_INTERRUPTS
	select MALI_DT
	help
	  Select S5P6818 SoC configuration
endchoice

choice
depends on MALI400
prompt "Select MALI VER"
default MALI_VER_R5P2_REL0

config MALI_VER_R6P2_01REL0
	bool "Mali400 Version R6P2-01REL0"
	help
	  Choose this option to select DDK version.

if MALI_VER_R6P2_01REL0
source "drivers/gpu/arm/mali400/r6p2_01rel0/Kconfig"
endif

config MALI_VER_R5P2_REL0
	bool "Mali400 Version R5P2-REL0"
	help
	  Choose this option to select DDK version.

if MALI_VER_R5P2_REL0
source "drivers/gpu/arm/mali400/r5p2_rel0/Kconfig"
endif

endchoice
```
